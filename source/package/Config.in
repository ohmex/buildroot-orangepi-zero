## source/package/Config.in
```kconfig
menu "Source packages"
menu "OrangePi tools"
	source "source/package/wiringop/Config.in"
endmenu
menu "Applications"
	source "source/package/sdlsuite/Config.in"
    source "source/package/rfidreader/Config.in"
endmenu
endmenu
```

## source/package/rfidreader/Config.in
```kconfig
config BR2_PACKAGE_RFIDREADER
	bool "rfidreader"
    select BR2_PACKAGE_LIBCURL
    select BR2_PACKAGE_JSON_C
	help
	  RFID reader application
```

## source/package/sdlsuite/Config.in
```kconfig
config BR2_PACKAGE_SDLSUITE
	bool "sdlsuite"
	depends on BR2_PACKAGE_QT5
	help
	  Simple SDL Application Suit
```

## source/package/wiringop/Config.in
```kconfig
config BR2_PACKAGE_WIRINGOP
	bool "wiringop"
	depends on BR2_USE_MMU
	depends on BR2_TOOLCHAIN_HAS_THREADS
	help
	  OrangePi wiringPi compatible libraries (and gpio command)

	  https://github.com/xpertsavenue/WiringOP-Zero

comment "wiringpi needs a toolchain w/ threads"
	depends on BR2_USE_MMU
	depends on !BR2_TOOLCHAIN_HAS_THREADS
```
